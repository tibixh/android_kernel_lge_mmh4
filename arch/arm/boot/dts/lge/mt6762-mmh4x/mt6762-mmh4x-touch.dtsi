/*
 * LG Electronics MT6765 HDK touch device tree source
 *
 * Copyright (c) 2018 LG Electronics Co., Ltd.
 *              http://www.lge.com
 *
 */

#include "../mt6762-mmh4x_touch_common/mt6762-mmh4x-touch.dtsi"
