/*
 * LG Electronics MH4 nfc device tree source
 *
 * Copyright (c) 2017 LG Electronics Co., Ltd.
 *              http://www.lge.com
 *
 */

&i2c3 {
	clock-frequency = <400000>;

	pn547@28 {
		compatible = "nxp,pn547";
		reg = <0x28>;
		status = "disabled";
	};
};