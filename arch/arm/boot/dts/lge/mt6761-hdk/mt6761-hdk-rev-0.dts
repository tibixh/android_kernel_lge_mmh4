#include <dt-bindings/interrupt-controller/arm-gic.h>
#include <dt-bindings/interrupt-controller/irq.h>
#include <dt-bindings/pinctrl/mt6761-pinfunc.h>
#include <dt-bindings/clock/mt6761-clk.h>

/dts-v1/;
/plugin/;

#include "mt6761-hdk-cust.dtsi"
#include "mt6761-hdk-panel.dtsi"
#include "mt6761-hdk-touch.dtsi"
#include "mt6761-hdk-common.dtsi"
#include "mt6761-hdk-sound.dtsi"
#include "mt6761-hdk-fingerprint.dtsi"
#include "mt6761-hdk-power.dtsi"
#include "mt6761-hdk-camera.dtsi"
#include "mt6761-hdk-sensor.dtsi"
#include "mt6761-hdk-misc.dtsi"
#include "mt6761-hdk-usb.dtsi"
/* #include "mt6761-hdk-mme.dtsi" */

/{
	board {
		/*
		   typedef enum {
		   HW_REV_0 = 0,
		   HW_REV_0_1,
		   HW_REV_A,
		   HW_REV_B,
		   HW_REV_C,
		   HW_REV_1_0,
		   HW_REV_1_1,
		   HW_REV_MAX
		   } rev_type;
		 */
		lge,pcb_revision = <0x0>; // rev_0
	};
};

/* chosen */
&chosen {

	/* fpga may has no lk, we need to specify display info here */
	/* fb buffer is reserved using this dts by memory node above */
	atag,videolfb-fb_base_h = <0x0>;
	atag,videolfb-fb_base_l = <0x5e605000>;
	atag,videolfb-islcmfound = <1>;
	/* because no lk, so lcm is not inited */
	atag,videolfb-islcm_inited = <0>;
	atag,videolfb-fps= <6000>;
	atag,videolfb-vramSize= <0x017bb000>;
	atag,videolfb-lcmname= "nt35695B_fhd_dsi_cmd_auo_rt5081_drv";
};

/*
&i2c3 {
	ext_buck_lp4@57 {
		regulator-name ="ext_buck_vdd2";
		regulator-min-microvolt = <300000>;
		regulator-max-microvolt = <1300000>;
		vsel_pin = <0>;
	};

	ext_buck_lp4x@50 {
		regulator-name ="ext_buck_vddq";
		regulator-min-microvolt = <300000>;
		regulator-max-microvolt = <1300000>;
		vsel_pin = <1>;
	};
};

&i2c6 {
	ext_buck_vgpu@55 {
		regulator-name ="ext_buck_vgpu";
		regulator-min-microvolt = <300000>;
		regulator-max-microvolt = <1300000>;
		vsel_pin = <2>;
	};
};
*/

/* IRTX GPIO end */
/*
&irtx_pwm {
	pinctrl-names = "irtx_gpio_led_default", "irtx_gpio_led_set";
	pinctrl-0 = <&irtx_gpio_led_default>;
	pinctrl-1 = <&irtx_gpio_led_set>;
	status = "okay";
};
&pio {
	irtx_gpio_led_default:irtx_gpio_led_def@gpio90 {
		pins_cmd_dat {
			pinmux = <PINMUX_GPIO90__FUNC_GPIO90>;
			slew-rate = <1>;
			bias-disable;
			output-low;
			input-schmitt-enable = <0>;
		};
	};

	irtx_gpio_led_set:irtx_gpio_led_set@gpio90 {
		pins_cmd_dat {
			pinmux = <PINMUX_GPIO90__FUNC_PWM0>;
			slew-rate = <1>;
			output-high;
		};
	};
};
*/
/* IRTX GPIO Settings -End */
