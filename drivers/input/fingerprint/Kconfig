## drivers/input/fingerprint/Kconfig
```kconfig
#
#Fingerprint
#
menu "Fingerprint support"
	depends on INPUT

config MTK_FINGERPRINT_SUPPORT
	bool "Mediatek Fingerprint"
	default n
	help
	  Fingerprint mtk driver enable/disable in the kernel.
	  Say Y here if you want to use mediatek fingerprint driver,
	  fingerprint driver will support fingerprint function

if MTK_FINGERPRINT_SUPPORT
#config MTK_FINGERPRINT_SELECT
#	string "sensor type"
#	default "GF318M"


#if MTK_FINGERPRINT_SELECT = "FPC1145"
config FPC_FINGERPRINT
	bool "FPC Fingerprint"
#	default y
#	help
#	  FPC fingerprint FPC's 102x/104x device.
#endif

#if MTK_FINGERPRINT_SELECT = "GF318M" ||  MTK_FINGERPRINT_SELECT = "GF5216"
config GOODIX_FINGERPRINT
	bool "Goodix Fingerprint"
#	default y
#	help
#	  Goodix Fingerprint chip GF316M/GF318M/GF3118M/GF518M/GF5118M/GF516M/GF816M/GF3208/GF3206/
#	  GF3266/GF3288/GF5206/GF5216/GF5208 TEE driver

#config GOODIX_SENSOR_TYPE
#	string "SENSOR_TYPE"
#	default "GF5216"
#	help
#	  Must input sensor type, or default is GF316M GF318M GF3118M GF518M GF5118M GF516M GF816M
#	  GF3208 GF3206 GF3266 GF3288 GF5206 GF5216 GF5208
#endif

config CDFINGER_FINGERPRINT
	bool "Fingertech Fingerprint"
	default n

if CDFINGER_FINGERPRINT
config CDFINGER_FINGERPRINT_ID_HI
	bool "fp id is high"
	default n

config CDFINGER_FINGERPRINT_ID_LO
	bool "fp id is low"
	default n
endif

config FOCALTECH_FINGERPRINT
	bool "Fingertech Fingerprint"
	default n

if FOCALTECH_FINGERPRINT
config FOCALTECH_FINGERPRINT_ID_HI
	bool "fp id is high"
	default n

config FOCALTECH_FINGERPRINT_ID_LO
	bool "fp id is low"
	default n
endif

endif
endmenu
```

## drivers/misc/mediatek/lcm/Kconfig
```kconfig
config MTK_LCM
	bool "Enable LCM driver"
	default n
	help
	  define LCM driver config to enable LCM driver.
	  To set LCM driver which you choose avoid cannot driver LCM.
	  Please make sure CONFIG_MTK_LCM in xxxxxx_defconfig.mk.
	  And also make sure true on in ProjectConfig.mk

config CUSTOM_KERNEL_LCM
	string "define mediatek kernel LCM driver"
	help
	  To choose kernel LCM driver name.
	  This config is to select which LCM driver you want to use.
	  Please make sure CUSTOME_KERNEL_LCM in xxxxx_defconfig.mk.
	  And also make sure turn on in ProjectConfig.mk

config MTK_LCM_DEVICE_TREE_SUPPORT
	bool "support LCM device tree connect with display drivers"
	help
	  Decide whether to support LCM device tree based configuration.
	  This feature requires the connection between display driver and LCM devices.
	  Please also turn on MTK_LCM_DEVICE_TREE_SUPPORT in ProjectConfig.mk.
	  If not define MTK_LCM_DEVICE_TREE_SUPPORT
	  there will not connect between display driver and LCM devices.

source "drivers/misc/mediatek/lcm/sw49106_fhdplus_dsi_vdo_lgd_cv5/Kconfig"
source "drivers/misc/mediatek/lcm/ft8736_hdplus_dsi_vdo_txd/Kconfig"
source "drivers/misc/mediatek/lcm/ili9881h_hdplus_dsi_vdo_djn/Kconfig"
source "drivers/misc/mediatek/lcm/hx83102d_hdplus_dsi_vdo_lce/Kconfig"
source "drivers/misc/mediatek/lcm/ili9881c_hdplus_dsi_vdo_kd/Kconfig"
source "drivers/misc/mediatek/lcm/ft8006m_hd720_dsi_vdo_tcl_cv1/Kconfig"
source "drivers/misc/mediatek/lcm/ft8006p_hdplus_dsi_vdo_auo/Kconfig"
source "drivers/misc/mediatek/lcm/st7703_hdplus_dsi_vdo_lce/Kconfig"
```

## drivers/power/supply/mediatek/lge/Kconfig
```kconfig
if LGE_PM

config LGE_PM_APPLE_CHARGER
	bool "LGE_PM Detect Apple Charger Support"
	default	n
	help
	  Say y here to support Detect Legacy Apple Charger.

config LGE_PM_APPLE_CHARGER_PULLDOWN
	bool "LGE_PM Detect Apple Charger Support for PULLDOWN"
	default	n
	help
	  Say y here to support Detect Legacy Apple Charger.

config LGE_PM_BATTERY_CYCLE
	bool "LG Electronic battery cycle count"
	default n
	help
	  Say Y here to support battery cycle count.

config LGE_PM_BATTERY_AGING_FACTOR
	bool "LG Electronic battery aging factor"
	default n
	depends on LGE_PM_BATTERY_CYCLE
	help
	  Say Y here to support battery aging factor.

config LGE_PM_BATTERY_ID
	bool "LG Electronic Battery ID"
	default n
	help
	  Say Y here to support check battery id.

config LGE_PM_BATTERY_NTC_TUNED
	bool "LG Electronic Battery NTC Tuning value"
	default n
	help
	  Say Y here to use tuning value of battery NTC.

config LGE_PM_BATTERY_PRESENT
	bool "LG Electronic Battery present related patch"
	default n
	help
	  Say Y here to apply battery present handling patch.

config LGE_PM_CHARGERLOGO
	bool "LG Electronic Chargerlogo related patch"
	default n
	help
	  Say Y here to apply patch for running chargerlogo.

config LGE_PM_CHARGER_CONTROLLER
	bool "LG Electronic Charger Controller"
	default n
	help
	  Say Y here to enable charger-controller.
	  This manage LG Electronics charging scenarios.

config LGE_PM_DEBUG_FS
	bool "LG Electronic debugfs for power management"
	depends on DEBUG_FS
	default n
	help
	  Say Y here to support power devices debugfs.

config LGE_PM_POWER_SYSFS
	bool "LG Electronic unified power sysfs"
	default n
	help
	  Say Y here to support unified power sysfs.

config LGE_PM_PSEUDO_POWER_SUPPLY
	bool "LG Electronic pseudo battery"
	default n
	help
	  Say Y here to support fake battery.

config LGE_PM_PSEUDO_BATTERY
	bool "LG Electronic pseudo battery"
	select LGE_PM_PSEUDO_POWER_SUPPLY
	default n
	help
	  Say Y here to support fake battery.

config LGE_PM_PSEUDO_HVDCP
	bool "LG Electronic pseudo hvdcp"
	select LGE_PM_PSEUDO_POWER_SUPPLY
	default n
	help
	  Say Y here to support fake hvdcp.

config LGE_PM_PUMP_EXPRESS_PLUS_ALGO
	bool "LG Electronic unified power sysfs"
	default n
	help
	  Say Y here to support unified power sysfs.

config LGE_PM_QNOVO_QNS
	bool "QNOVO QNS System support"
	default n
	help
	  Say Y to enable support QNOVO QNS system

config LGE_PM_USB_ID
	bool "Support LGE PM USB ID feature"
	default n
	help
	  LGE PM USB ID about cable detection, etc

endif # LGE_PM

config CHARGER_BQ25910
	bool "Charger Driver for Texas Instruments BQ25910 Charger IC"
	default n
	depends on MTK_CHARGER
	help
	  Say Yes to enable Texas Instruments BQ25910 driver.
	  It is mainly used as slave IC for dual charger application.
```
