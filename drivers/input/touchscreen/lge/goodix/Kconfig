## drivers/input/touchscreen/lge/goodix/Kconfig
```kconfig
#
# LGE touch core configuration
#
if INPUT_TOUCHSCREEN

source "drivers/input/touchscreen/lge/goodix/gt917d/Kconfig"

endif
```

## drivers/input/touchscreen/lge/goodix/gt917d/Kconfig
```kconfig
#
# LGE touch core configuration
#
if INPUT_TOUCHSCREEN

menuconfig LGE_TOUCH_GOODIX_GT917D
	bool "LGE Touch Core ODM Device Driver - GT917D"
	depends on LGE_TOUCH_CORE_BASE
	help
	  If your device is gt917d, say Y
# To Do : Focal Tech Chipseet

endif
```

## drivers/input/touchscreen/lge/himax/Kconfig
```kconfig
#
# LGE touch core configuration
#
if INPUT_TOUCHSCREEN

menuconfig LGE_TOUCH_HIMAX_HX83102D
	bool "LGE Touch Core ODM Device Driver - HX83102D"
	depends on LGE_TOUCH_CORE_BASE
	help
	  If your device is hx83102d, say Y

menuconfig LGE_TOUCH_HIMAX_HX8527
	bool "LGE Touch Core ODM Device Driver - HX8527"
	depends on LGE_TOUCH_CORE_BASE
	help
	  If your device is hx8527, say Y
# To Do : HIMAX Chipseet
endif
```

## drivers/input/touchscreen/lge/himax/hx8527/Kconfig
```kconfig
#
# LGE touch core configuration
#
if INPUT_TOUCHSCREEN

menuconfig LGE_TOUCH_HIMAX_HX8527
	bool "LGE Touch Core ODM Device Driver - HX8527"
	depends on LGE_TOUCH_CORE_BASE
	help
	  If your device is hx8527, say Y

menuconfig LGE_TOUCH_HIMAX_HX8527_DEBUG
	bool "LGE Touch Core ODM Device Driver - HX8527"
	depends on LGE_TOUCH_CORE_BASE
	help
	  If your device is hx8527, say Y
endif
```

## drivers/input/touchscreen/lge_oos/focaltech/Kconfig
```kconfig
#
# LGE touch core configuration
#
if INPUT_TOUCHSCREEN

source "drivers/input/touchscreen/lge_oos/focaltech/FT8006P/Kconfig"

endif
```

## drivers/misc/mediatek/lcm/ft8006p_hdplus_dsi_vdo_auo/Kconfig
```kconfig
config FT8006P_HDPLUS_DSI_VDO_AUO
    bool "Enable AUO FT8006P INCELL HDPLUS panel for MH4""
    default n
```

## drivers/misc/mediatek/lcm/ft8006p_hdplus_dsi_vdo_lce/Kconfig
```kconfig
config FT8006P_HDPLUS_DSI_VDO_LCD
    bool "Enable LCE FT8006P INCELL HDPLUS panel for MH4""
    default n
```

## drivers/misc/mediatek/lcm/ft8006p_hdplus_dsi_vdo_tianma/Kconfig
```kconfig
config FT8006P_HDPLUS_DSI_VDO_TIANMA
    bool "Enable TIANMA FT8006P INCELL HDPLUS panel for MH4""
    default n
```

## drivers/misc/mediatek/lcm/ft8006p_hdplus_dsi_vdo_txd/Kconfig
```kconfig
config FT8006P_HDPLUS_DSI_VDO_TXD
    bool "Enable TXD FT8006P INCELL HDPLUS panel for MH4""
    default n
```

## drivers/misc/mediatek/lcm/ft8736_hdplus_dsi_vdo_txd/Kconfig
```kconfig
config FT8736_HDPLUS_DSI_VDO_TXD
	bool "Enable TXD FT8736 INCELL HD+ panel for MMH4"
	default n
	help
		TXD FT8736 INCELL HD+ panel for MMH4
```

## drivers/misc/mediatek/lcm/hx83102d_hdplus_dsi_vdo_lce/Kconfig
```kconfig
config HX83102D_HDPLUS_DSI_VDO_LCE
	bool "Enable LCE HX83102D INCELL HD+ panel for MMH4"
	default n
	help
		LCE HX83102D INCELL HD+ panel for MMH4
```

## drivers/misc/mediatek/lcm/ili9881c_hdplus_dsi_vdo_kd/Kconfig
```kconfig
config ILI9881C_HDPLUS_DSI_VDO_KD
    bool "Enable KD ILI9881C INCELL HDPLUS panel for MH4P""
    default n
```

## drivers/misc/mediatek/lcm/ili9881c_hdplus_dsi_vdo_lce/Kconfig
```kconfig
config ILI9881C_HDPLUS_DSI_VDO_LCE
    bool "Enable LCE ILI9881C ONCELL HDPLUS panel for MH55""
    default n
```

## drivers/misc/mediatek/lcm/ili9881h_hdplus_dsi_vdo_djn/Kconfig
```kconfig
config ILI9881H_HDPLUS_DSI_VDO_DJN
	bool "Enable DJN ILI9881H INCELL HD+ panel for MH4"
	default n
	help
		DJN ILI9881H INCELL HD+ panel for MH4
```

## drivers/misc/mediatek/lcm/jd9365d_hdplus_dsi_vdo_hlt/Kconfig
```kconfig
config JD9365D_HDPLUS_DSI_VDO_HLT
    bool "Enable SKI JD9365D ONCELL HDPLUS panel for MH55""
    default n
```

## drivers/misc/mediatek/lcm/jd9365da_hdplus_dsi_vdo_ski/Kconfig
```kconfig
config JD9365DA_HDPLUS_DSI_VDO_SKI
    bool "Enable SKI JD9365DA INCELL HDPLUS panel for MH4P""
    default n
```

## drivers/misc/mediatek/lcm/jd9365z_hdplus_dsi_vdo_kd/Kconfig
```kconfig
config JD9365Z_HDPLUS_DSI_VDO_KD
    bool "Enable KD JD9365Z INCELL HDPLUS panel for MH5""
    default n
```

## drivers/misc/mediatek/lcm/st7703_hdplus_dsi_vdo_lce/Kconfig
```kconfig
config ST7703_HDPLUS_DSI_VDO_LCE
    bool "Enable LCE ST7703 ONCELL HDPLUS panel for DH10""
    default n
```

## drivers/misc/mediatek/vibrator/Kconfig
```kconfig
config MTK_VIBRATOR
	tristate "MediaTek Vibrator driver"
	default n
	  ---help---
	  Vibrator driver support for MediaTek SOC.
	  You can customize the vibrate strength and lowest vibrate time.
	  If you want to use MediaTek Vibrator driver, say Y or M here.
	  If unsure, say N.

config LGE_VIBRATOR_TEST
        bool "LGE Vibrator Test Feature"
        default n
          ---help---
          Test vibrator driver for LGE.
```
